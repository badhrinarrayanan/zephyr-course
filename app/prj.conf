## prj.conf
```kconfig
CONFIG_GPIO=y
CONFIG_CONSOLE=y
CONFIG_UART_CONSOLE=y
CONFIG_PRINTK=y
CONFIG_HWINFO=y
```

## esp32s3_devkitc_esp32s3_procpu.overlay
```dts
/ {
    aliases {
        led0 = &external_led;
    };

    leds {
        compatible = "gpio-leds";
        external_led: external_led {
            gpios = <&gpio0 4 GPIO_ACTIVE_HIGH>;
            label = "External LED on GPIO 4";
        };
    };
};
```

## src/main.c
```c
#include <zephyr/kernel.h>
#include <zephyr/drivers/gpio.h>

static const struct gpio_dt_spec led = GPIO_DT_SPEC_GET(DT_ALIAS(led0), gpios);

int main(void)
{
    if (!gpio_is_ready_dt(&led)) {
        return 0;
    }

    gpio_pin_configure_dt(&led, GPIO_OUTPUT_ACTIVE);

    while (1) {
        gpio_pin_toggle_dt(&led);
        k_msleep(1000);
    }
}
```
